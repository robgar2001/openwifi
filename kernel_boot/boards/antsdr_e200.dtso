/dts-v1/;
/plugin/;

/ {
    // Insert leds
    fragment@0{
        target-path= "/";
        __overlay__{
            leds {
                compatible = "gpio-leds";

                led0 {
                    label = "led0:green";
                    gpios = <0x6 0x0 0>;
                    linux,default-trigger = "heartbeat";
                };
            };
        };
    };
};